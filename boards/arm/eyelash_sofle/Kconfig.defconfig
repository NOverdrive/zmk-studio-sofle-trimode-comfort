## boards/arm/eyelash_sofle/Kconfig.shield
```kconfig
# Copyright (c) 2020 Ryan Cross
# SPDX-License-Identifier: MIT

config SHIELD_EYELASH_SOFLE_DONGLE
    def_bool $(shields_list_contains,eyelash_sofle_dongle)
```

## config/west.yml
```yaml
manifest:
  remotes:
    - name: zmkfirmware
      url-base: https://github.com/zmkfirmware
      # Additional modules containing boards/shields/custom code can be listed here as well.
      # See:
      # - https://zmk.dev/docs/features/modules
      # - https://docs.zephyrproject.org/3.5.0/develop/west/manifest.html#projects
    # nice_view_gem
    #- name: m165437
      #url-base: https://github.com/M165437
    #my_projects
    - name: noverdrive
      url-base: https://github.com/NOverdrive
    # dongle_display
    #- name: englmaxi
      #url-base: https://github.com/englmaxi
    # nice_oled - dongle_display!view - oled Adapter
    #- name: mctechnology17
      #url-base: https://github.com/mctechnology17
    #nice view elemental
    #- name: kevinpastor
      #url-base: https://github.com/kevinpastor
    - name: gpeye
      url-base: https://github.com/GPeye
  projects:
    - name: eyelash_sofle
      url: https://github.com/a741725193/zmk-sofle
      revision: dongle
    - name: hammerbeam-slideshow          #new entry
      remote: gpeye                       #new entry
      revision: main                      #new entry
    #- name: nice-view-gem #new entry
      #remote: m165437 #new entry
      #revision: main #new entry
    - name: Mirror-Gem
      remote: noverdrive
      revision: Overdrive
    - name: Hammerbeam
      remote: noverdrive
      revision: Overdrive-ver
    #- name: nice-view-elemental
      #remote: kevinpastor
      #revision: main
    # dongle_display
    #- name: zmk-dongle-display
      #remote: englmaxi
      #revision: main
    # nice_oled
    #- name: zmk-nice-oled
      #remote: mctechnology17
      #revision: main
    # dongle_display!view
    #- name: zmk-dongle-display-view
      #remote: mctechnology17
      #revision: main
    # oled Adapter
    #- name: zmk-oled-adapter
      #remote: mctechnology17
      #revision: main
    - name: zmk
      remote: zmkfirmware
      revision: main
      import: app/west.yml
  self:
    path: config
```
